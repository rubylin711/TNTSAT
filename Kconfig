## common/drv/Kconfig
```kconfig
menu "Montage Common"

config MT_COMMON
	bool "Common Driver"
	default y
	depends on MT_CHIP_COMMON
	help
	  Montage Common Driver

endmenu
```

## component/wifi/drv/Flax_wi6700/host/Kconfig
```kconfig
config LYNX_ROM2
	bool "LYNX ROM2 (A1 silicon version)"
	default n

config LYNX_ROM3
	bool "LYNX ROM3 (A2 silicon version)"
	default n	
	
config LYNX_IBSS
	bool "LYNX IBSS function support"
	depends on LYNX_WM_MANAGER
	default y

config LYNX_DEBUG
	bool "LYNX debug file system support"
	default n

config LYNX_W2USB
	tristate "LYNX wifi with USB interface"
	default m

config LYNX_W2USB_FIRMWARE_ARRAY
	bool "LYNX USB use built-in firmware array rather than user-land's"
	depends on LYNX_W2USB
	default y

config LYNX_W2USB_NO_RESET
	bool "LYNX USB no reset"
	depends on LYNX_W2USB
	default n

config LYNX_W2SDIO
	tristate "LYNX wifi with SDIO interface"
	depends on !LYNX_W2USB
	default n

config LYNX_W2SDIO_FIRMWARE_ARRAY
	bool "LYNX SDIO use built-in firmware array rather than user-land's"
	depends on LYNX_W2SDIO
	default n

config SDIO_POLLING
	bool "LYNX SDIO use the polling mode in the RX path"
	depends on LYNX_W2SDIO
	default n

config LYNX_OS_LINUX
	bool "LYNX working OS == Linux"
	default y

config LYNX_WM_MANAGER
	bool "LYNX wifi manager function support"
	default n

config LYNX_WPA
	bool "LYNX WPA function support"
	depends on LYNX_WM_MANAGER
	default n

config CUST1_PRIV_BEACON_IE
	bool "LYNX support privately beacon ie for customer 1."
	default n
#	depends on !HOST_WPS

config HOST_WPS
	bool "LYNX use hostapd or wpa_supplicant do WPS process"
	depends on !CUST1_PRIV_BEACON_IE
	default n

config HOST_P2P
	bool "LYNX support to provide p2p interface controlled by wpa_supplicant"
	depends on HOST_WPS
	default n

config SUPPORT_MONITOR_MODE
	bool "LYNX support interface type as NL80211_IFTYPE_MONITOR"
	default n

config LYNX_POWER_SAVING
	bool "LYNX enable power saving by default"
	default n

config TIMER_HANDLER
	bool "LYNX enable timer handler function"
	default y

config LYNX_STATICS
	bool "LYNX record the device static info"
	default y

config DISABLE_HT40
	bool "LYNX disable HT40 ability"
	default n

config ENABLE_TXOPLIMIT_AP
	bool "LYNX enable using AP txoplimit " 
	default n
	
config UNIT_TEST
	bool "LYNX unit test func"
	depends on LYNX_DEBUG
	default n

config HOST_DEBUG_DEVICE
	bool "LYNX gets the device debug info"
	depends on LYNX_DEBUG
	default n
config MP_FW
	bool "LYNX MP FW"
	default n
config CH_15
	bool "LYNX SUPPORT CHANNEL 15"
	default n
config LOW_FREQ_CH
	bool "LYNX SUPPORT LOW FREQUENCY CHANNEL "
	default n

config HOST_ROAMING
	bool "LYNX support host roaming controlled by wpa_supplicant"
	default n
	
```

## msp/drv/Kconfig
```kconfig
menu "Montage MSP"

menuconfig MT_MSP
	tristate "MSP Driver"
	default y
	depends on MT_CHIP_COMMON
	help
	  Montage MSP Driver

if MT_MSP

config MT_AVPLAY
	bool "AVPlay"
	default y
	help
	  Montage AV Play

config MT_SPDMA
	bool "SPDma"
	default n
	help
	  Montage SPDma

menuconfig MT_VDEC
	bool "VDEC"
	default y
	help
	  Montage Video Decoder

if MT_VDEC

config MT_VFMW
	tristate "VFMW"
	default n
	depends on MT_CHIP_SYMPHONY4 || MT_CHIP_ARIA || MT_CHIP_SYMPHONY6
	help
	  Montage VFMW

endif #MT_VDEC

config MT_SYNC
	bool "AVSync"
	default y
	help
	  Montage AV Sync

source "drivers/$(MT_TOPDIR_REL_PATH)/msp/drv/aiao/Kconfig"

config MT_ADEC
	bool "ADEC"
	default y
	help
	  Montage Audio Decoder

config MT_PVR
	bool "PVR"
	default y
	help
	  Montage PVR

menuconfig MT_VO
	bool "VO"
	default y
	help
	  Montage Video Output Driver

if MT_VO

config MT_VO_SL_HDR
	tristate "SL_HDR"
	default y
	depends on MT_CHIP_SYMPHONY4 || MT_CHIP_SYMPHONY6
	help
	  Montage Technicolor HDR Driver

config MT_VO_FW
	tristate "VO_FW"
	default y
	help
	  Montage Video Output Firmware

endif #MT_VO

config MT_OPTM
	bool "OPTM"
	default y
	help
	  Montage Physical OPTM

config MT_MTFB
	bool "MTFB"
	default y
	help
	  Montage Framebuffer

config MT_TDE
	bool "TDE"
	default y
	help
	  Montage TDE

config MT_OSD
	bool "OSD"
	default y
	help
	  Montage OSD

config MT_DEMUX
	bool "Demux"
	default y
	help
	  Montage Demux

menuconfig MT_SECURITY
	bool "Montage Security"
	default y
	help
	  Montage Security Driver

if MT_SECURITY

config MT_IPCS
    bool "IPCS"
    default y
    help
      Montage Secure Mailbox

config MT_CIPHER_SCPU
    bool "CIPHER_SCPU"
    default y
    help
      Montage CIPHER_SCPU

config MT_KEYLADDER
	bool "KeyLadder"
	default y
	help
	  Montage KeyLadder Driver

source "drivers/$(MT_TOPDIR_REL_PATH)/msp/drv/crypto_engine/Kconfig"

source "drivers/$(MT_TOPDIR_REL_PATH)/msp/drv/keytable/Kconfig"

config MT_CERT
	bool "Cert"
	default y
	depends on MONTAGE_NAGRA
	help
	  Montage Cert

source "drivers/$(MT_TOPDIR_REL_PATH)/msp/drv/opc/Kconfig"

source "drivers/$(MT_TOPDIR_REL_PATH)/msp/drv/vss/Kconfig"

endif #MT_SECURITY

config MT_PNG
	bool "PNG"
	default y
	depends on MT_CHIP_SYMPHONY4 || MT_CHIP_SYMPHONY6
	help
	  Montage PNG

source "drivers/$(MT_TOPDIR_REL_PATH)/msp/drv/keyled/Kconfig"
source "drivers/$(MT_TOPDIR_REL_PATH)/msp/drv/frontend/Kconfig"

config MT_LXC_IPC
	bool "Linux Container IPC"
	default n
	help
	  Montage Linux Container IPC

menu "CI Plus"

config MT_SMIT_USB_CAM
	tristate "smit usb cam driver"
	default y
	help
	  SMIT usb cam

config MT_PCMCIA_CI
	tristate "montage pcmcia ciplus controller"
	default m
	depends on (MT_CHIP_SYMPHONY4 || MT_CHIP_SYMPHONY6)
	help
	  montage pcmcia ciplus controller driver

endmenu

menuconfig MT_HDMI_VER20
	bool "HDMI Ver(1.4/2.0)"
	default y
	depends on MT_CHIP_SYMPHONY6 || MT_CHIP_ETUDE2
	help
	  HDMI Ver(1.4/2.0)

if MT_HDMI_VER20

config MT_HDMI_V20_DEBUG_PROC_FS
	bool "PROC_FS"
	default y
	help
	  HDMI PROC FUNCTION
	  
config MT_HDMI_V20_DEBUG_SYSFS
	bool "SYSFS"
	default n
	help
	  HDMI SYSFS FUNCTION
	  
endif #MT_HDMI_VER20  

if MT_CHIP_SYMPHONY4
menu "Audio DAI"
source "drivers/$(MT_TOPDIR_REL_PATH)/msp/drv/dai/Kconfig"
endmenu
endif

config MT_CHIP_VERIFICATION
	bool "chip verification"
	default n
	help
	  compile msp/drv/chip_verification

endif #MT_MSP

endmenu
```

## msp/drv/aiao/Kconfig
```kconfig
menuconfig MT_AIAO
	bool "AIAO"
	default y
	depends on MT_MSP
	help
	  Montage AIn AOut Driver

if MT_AIAO

config MT_AIN
	bool "AIN"
	default y
	help
	  Montage Audio Input

endif #MT_AIAO
```

## msp/drv/crypto_engine/Kconfig
```kconfig
menuconfig MT_CRYPTOENGINE
	bool "CryptoEngine"
	default y
	depends on MT_SECURITY
	help
	  Montage CryptoEngine

if MT_CRYPTOENGINE

config MT_CRYPTOENGINE_SYM2
	bool "CryptoEngine sym2"
	default y
	depends on MT_CHIP_SYMPHONY2
	help
	  Montage CryptoEngine sym2

config MT_CRYPTOENGINE_SYM4
	bool "CryptoEngine sym4"
	default y
	depends on MT_CHIP_SYMPHONY4
	help
	  Montage CryptoEngine sym4

config MT_CRYPTOENGINE_SYM6
	bool "CryptoEngine sym6"
	default y
	depends on MT_CHIP_SYMPHONY6
	help
	  Montage CryptoEngine sym6

config MT_CRYPTOENGINE_SYM6_HW_IRQ_SUPPORT
	bool "CryptoEngine sym6 hw irq support"
	default y
	depends on MT_CHIP_SYMPHONY6
	help
	  Montage CryptoEngine sym6 hw irq support

endif #MT_CRYPTOENGINE
```

## msp/drv/dai/Kconfig
```kconfig
config SYMPHONY_SMART_SPEAKER
       bool "Enable kernel configurations for smart speaker applications"
       default n

config PANTHER_SND
	tristate "Sound driver"
	depends on SYMPHONY_SMART_SPEAKER
	select SOUND
	select SND
	select SND_SOC
	default n

config PANTHER_SND_ENABLE_NETLINK
	bool "Send netlink event on output silence"
	depends on PANTHER_SND
	default n

config PANTHER_SND_LPSD
	bool "Low Power Sound Detector"
	depends on PANTHER_SND
	default n
	help
	  This enables a Low Power Sound Detector for 16KHz 16bit stream

config PANTHER_SND_LPSD_TARGET
	int "monitor target selection Rx(0/1)"
	depends on PANTHER_SND_LPSD
	range 0 1
	default 0

choice
	prompt "PDM interface"
	depends on PANTHER_SND
	default PANTHER_SND_PDM_RX0

config PANTHER_SND_PDM_RX0
	bool "RX0"
config PANTHER_SND_PDM_RX1
	bool "RX1"
endchoice

config PANTHER_SND_TX_EXT_CARD
	bool "TX External Card"
	depends on PANTHER_SND
	select I2C
	select I2C_MT_SYMPHONY
	default y

choice
	prompt "Tx Codec select"
	depends on PANTHER_SND_TX_EXT_CARD
	default PANTHER_SND_TX_ES8311

config PANTHER_SND_TX_DUMMY
	bool "DUMMY codec"
	select PANTHER_SND_CODEC_DUMMY
config PANTHER_SND_TX_PCM1681
	bool "TI PCM1681"
	select PANTHER_SND_CODEC_PCM1681
config PANTHER_SND_TX_ES8311
	bool "Everest ES8311"
	select PANTHER_SND_CODEC_ES8311
endchoice

config PANTHER_SND_TX_I2C_BUS
	int "I2C bus number of TX codec"
	depends on PANTHER_SND_TX_EXT_CARD
	default 1

config PANTHER_SND_RX_EXT_CARD
	bool "RX External Card"
	depends on PANTHER_SND
	select I2C
	select I2C_MT_SYMPHONY
	default y

choice
	prompt "Rx Codec select"
	depends on PANTHER_SND_RX_EXT_CARD
	default PANTHER_SND_RX_ES7210

config PANTHER_SND_RX_DUMMY
	bool "DUMMY codec"
	select PANTHER_SND_CODEC_DUMMY
config PANTHER_SND_RX_ES7210
	bool "Everest ES7210"
	select PANTHER_SND_CODEC_ES7210
endchoice

config PANTHER_SND_RX_I2C_BUS
	int "I2C bus number of RX codec"
	depends on PANTHER_SND_RX_EXT_CARD
	default 1

config PANTHER_SND_BCLK_SHARED
	bool "Tx and Rx use the same bit clock pin"
	depends on PANTHER_SND_TX_EXT_CARD && PANTHER_SND_RX_EXT_CARD
	default 0

config PANTHER_SND_FS_SHARED
	bool "Tx and Rx use the same frame sync pin"
	depends on PANTHER_SND_TX_EXT_CARD && PANTHER_SND_RX_EXT_CARD
	select PANTHER_SND_BCLK_SHARED
	default 0

config PANTHER_SND_CODEC_DUMMY
	bool
config PANTHER_SND_CODEC_ES7210
	bool
config PANTHER_SND_CODEC_PCM1681
	bool
config PANTHER_SND_CODEC_ES8311
	bool
```

## msp/drv/frontend/Kconfig
```kconfig
menuconfig MT_FRONTEND
	bool "Frontend"
	default y
	depends on MT_MSP
	help
	  Montage Frontend Driver

source "drivers/$(MT_TOPDIR_REL_PATH)/msp/drv/frontend/cs8000_cab/Kconfig"
source "drivers/$(MT_TOPDIR_REL_PATH)/msp/drv/frontend/cs8000_sat/Kconfig"
source "drivers/$(MT_TOPDIR_REL_PATH)/msp/drv/frontend/ct8k/Kconfig"
source "drivers/$(MT_TOPDIR_REL_PATH)/msp/drv/frontend/dm6000/Kconfig"
source "drivers/$(MT_TOPDIR_REL_PATH)/msp/drv/frontend/m88dd3k/Kconfig"
source "drivers/$(MT_TOPDIR_REL_PATH)/msp/drv/frontend/tc6930/Kconfig"
source "drivers/$(MT_TOPDIR_REL_PATH)/msp/drv/frontend/sony_cxd2856/Kconfig"
source "drivers/$(MT_TOPDIR_REL_PATH)/msp/drv/frontend/cs8800/Kconfig"
source "drivers/$(MT_TOPDIR_REL_PATH)/msp/drv/frontend/rs6060/Kconfig"
source "drivers/$(MT_TOPDIR_REL_PATH)/msp/drv/frontend/tp5001/Kconfig"
source "drivers/$(MT_TOPDIR_REL_PATH)/msp/drv/frontend/ds6103/Kconfig"
source "drivers/$(MT_TOPDIR_REL_PATH)/msp/drv/frontend/ds6113/Kconfig"
source "drivers/$(MT_TOPDIR_REL_PATH)/msp/drv/frontend/hd2502/Kconfig"
source "drivers/$(MT_TOPDIR_REL_PATH)/msp/drv/frontend/sony_cxd_family/Kconfig"
```

## msp/drv/frontend/cs8000_cab/Kconfig
```kconfig
menuconfig MT_FRONTEND_DMD_CS8K_CABLE
	bool "CS8000_Cable"
	default y
	depends on MT_FRONTEND && MT_CHIP_SYMPHONY1
	help
	  Montage Frontend CS8000 Cable Driver

if MT_FRONTEND_DMD_CS8K_CABLE

config MT_FRONTEND_DMD_CS8K_CABLE_TN_TC2800
	bool "TC2800 Tuner"
	default y
	help
	  Montage TC2800 Tuner

config MT_FRONTEND_DMD_CS8K_CABLE_TN_TC3800
	bool "TC3800 Tuner"
	default y
	help
	  Montage TC3800 Tuner

config MT_FRONTEND_DMD_CS8K_CABLE_TN_TC6800
	bool "TC6800 Tuner"
	default y
	help
	  Montage TC6800 Tuner

config MT_FRONTEND_DMD_CS8K_CABLE_TN_TDA18250
	bool "TDA18250 Tuner"
	default y
	help
	  Montage TDA18250 Tuner

config MT_FRONTEND_DMD_CS8K_CABLE_TN_R836
	bool "R836 Tuner"
	default y
	help
	  Montage R836 Tuner

config MT_FRONTEND_DMD_CS8K_CABLE_TN_MXL203
	bool "MXL203 Tuner"
	default y
	help
	  Montage MXL203 Tuner

config MT_FRONTEND_DMD_CS8K_CABLE_TN_MXL608
	bool "MXL608 Tuner"
	default y
	help
	  Montage MXL608 Tuner

endif #MT_FRONTEND_DMD_CS8K_CABLE
```

## msp/drv/frontend/cs8000_sat/Kconfig
```kconfig
menuconfig MT_FRONTEND_DMD_CS8K_SATELLITE
	bool "CS8000_Satellite"
	default y
	depends on MT_FRONTEND && MT_CHIP_SYMPHONY1
	help
	  Montage Frontend CS8000 Satellite Driver

if MT_FRONTEND_DMD_CS8K_SATELLITE

config MT_FRONTEND_DMD_CS8K_SATELLITE_TN_TS2022
	bool "TS2022 Tuner"
	default y
	help
	  Montage TS2022 Tuner

config MT_FRONTEND_DMD_CS8K_SATELLITE_TN_TS6011
	bool "TS6011 Tuner"
	default y
	help
	  Montage TS6011 Tuner

endif #MT_FRONTEND_DMD_CS8K_SATELLITE
```

## msp/drv/frontend/cs8800/Kconfig
```kconfig
menuconfig MT_FRONTEND_DMD_CS8800
	bool "CS8800"
	default y
	depends on MT_FRONTEND && (MT_CHIP_SYMPHONY4 || MT_CHIP_SYMPHONY6)
	help
	  Montage Frontend CS8800 Driver

if MT_FRONTEND_DMD_CS8800

config MT_FRONTEND_DMD_CS8800_TN_TS6011
	bool "TS6011 Tuner"
	default y
	help
	  Montage TS6011 Tuner

config MT_FRONTEND_DMD_CS8800_TN_MXL601
	bool "MXL601 Tuner"
	default y
	help
	  Montage MXL603 Tuner

config MT_FRONTEND_DMD_CS8800_TN_MXL603
	bool "MXL603 Tuner"
	default y
	help
	  Montage MXL603 Tuner

config MT_FRONTEND_DMD_CS8800_TN_RDA5815S
	bool "RDA5815S Tuner"
	default y
	help
	  Montage RDA5815S Tuner

config MT_FRONTEND_DMD_CS8800_TN_TC6800
	bool "TC6800 Tuner"
	default y
	help
	  Montage TC6800 Tuner

config MT_FRONTEND_DMD_CS8800_TN_RT720
	bool "RT720 Tuner"
	default y
	help
	  Rafael RT720 Tuner

endif #MT_FRONTEND_DMD_CS8800
```

## msp/drv/frontend/ct8k/Kconfig
```kconfig
menuconfig MT_FRONTEND_DMD_CT8K
	bool "CT8000"
	default y
	depends on MT_FRONTEND && MT_CHIP_SYMPHONY2
	help
	  Montage Frontend CT8000 Driver

if MT_FRONTEND_DMD_CT8K

config MT_FRONTEND_DMD_CT8K_TN_TS2022
	bool "TS2022 Tuner"
	default y
	help
	  Montage TS2022 Tuner

config MT_FRONTEND_DMD_CT8K_TN_TS6011
	bool "TS6011 Tuner"
	default y
	help
	  Montage TS6011 Tuner

config MT_FRONTEND_DMD_CT8K_TN_RDA5815M
	bool "RDA5815M Tuner"
	default y
	help
	  RDA 5815M Tuner

config MT_FRONTEND_DMD_CT8K_TN_MXL601
	bool "MXL601 Tuner"
	default y
	help
	  MaxLinear MxL601 Tuner

config MT_FRONTEND_DMD_CT8K_TN_MXL603
	bool "MXL603 Tuner"
	default y
	help
	  MaxLinear MxL603 Tuner

config MT_FRONTEND_DMD_CT8K_TN_RDA5815S
	bool "RDA5815S Tuner"
	default y
	help
	  RDA 5815S Tuner

config MT_FRONTEND_DMD_CT8K_TN_TC3800
	bool "TC3800 Tuner"
	default y
	help
	  Montage TC3800 Tuner

config MT_FRONTEND_DMD_CT8K_TN_TC6800
	bool "TC6800 Tuner"
	default y
	help
	  Montage TC6800 Tuner

endif #MT_FRONTEND_DMD_CT8K
```

## msp/drv/frontend/dm6000/Kconfig
```kconfig
menuconfig MT_FRONTEND_DMD_DM6K
	bool "DM6000"
	default y
	depends on MT_FRONTEND
	help
	  Montage Frontend DM6000 Driver

if MT_FRONTEND_DMD_DM6K

config MT_FRONTEND_DMD_DM6K_TN_TS2022
	bool "TS2022 Tuner"
	default y
	help
	  Montage TS2022 Tuner

config MT_FRONTEND_DMD_DM6K_TN_TS6011
	bool "TS6011 Tuner"
	default y
	help
	  Montage TS6011 Tuner

config MT_FRONTEND_DMD_DM6K_TN_MXL601
	bool "MXL601 Tuner"
	default y
	help
	  Montage MXL601 Tuner

config MT_FRONTEND_DMD_DM6K_TN_MXL603
	bool "MXL603 Tuner"
	default y
	help
	  Montage MXL603 Tuner

config MT_FRONTEND_DMD_DM6K_TN_RDA5815S
	bool "RDA5815S Tuner"
	default y
	help
	  Montage RDA5815S Tuner

config MT_FRONTEND_DMD_DM6K_TN_TC3800
	bool "TC3800 Tuner"
	default y
	help
	  Montage TC3800 Tuner

config MT_FRONTEND_DMD_DM6K_TN_TC6800
	bool "TC6800 Tuner"
	default y
	help
	  Montage TC6800 Tuner

endif #MT_FRONTEND_DMD_DM6K
```

## msp/drv/frontend/ds6103/Kconfig
```kconfig
menuconfig MT_FRONTEND_DMD_DS6103
	bool "DS6103"
	default n
	depends on MT_FRONTEND
	help
	  Montage Frontend DS6103 Driver

if MT_FRONTEND_DMD_DS6103

config MT_FRONTEND_DMD_DS6103_TN_TS6011
	bool "TS6011 Tuner"
	default y
	help
	  Montage TS6011 Tuner

config MT_FRONTEND_DMD_DS6103_TN_RDA5815S
	bool "RDA5815S Tuner"
	default n
	help
	  Montage RDA5815S Tuner

config MT_FRONTEND_DMD_DS6103_TN_RDA5815M
	bool "RDA5815M Tuner"
	default n
	help
	  Montage RDA5815M Tuner

config MT_FRONTEND_DMD_DS6103_TN_AV2012
	bool "AV2012 Tuner"
	default n
	help
	  AV2012 Tuner

config MT_FRONTEND_DMD_DS6103_TN_AV2018
	bool "AV2018 Tuner"
	default n
	help
	  AV2018 Tuner

endif #MT_FRONTEND_DMD_DS6103
```
