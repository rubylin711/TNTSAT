## msp/drv/frontend/ds6113/Kconfig
```kconfig
menuconfig MT_FRONTEND_DMD_DS6113
	bool "DS6113"
	default n
	depends on MT_FRONTEND
	help
	  Montage Frontend DS6113 Driver

if MT_FRONTEND_DMD_DS6113

config MT_FRONTEND_DMD_DS6113_TN_TS6011
	bool "TS6011 Tuner"
	default y
	help
	  Montage TS6011 Tuner

config MT_FRONTEND_DMD_DS6113_TN_RDA5815S
	bool "RDA5815S Tuner"
	default n
	help
	  Montage RDA5815S Tuner

config MT_FRONTEND_DMD_DS6113_TN_RDA5815M
	bool "RDA5815M Tuner"
	default n
	help
	  Montage RDA5815M Tuner

config MT_FRONTEND_DMD_DS6113_TN_AV2012
	bool "AV2012 Tuner"
	default n
	help
	  AV2012 Tuner

config MT_FRONTEND_DMD_DS6113_TN_AV2018
	bool "AV2018 Tuner"
	default n
	help
	  AV2018 Tuner

endif #MT_FRONTEND_DMD_DS6113
```

## msp/drv/frontend/hd2502/Kconfig
```kconfig
menuconfig MT_FRONTEND_DMD_HD2502
	bool "HD2502"
	default n
	depends on MT_FRONTEND
	help
	  HDIC Frontend HD2502 Driver
```

## msp/drv/frontend/m88dd3k/Kconfig
```kconfig
menuconfig MT_FRONTEND_DMD_DD3K
	bool "DD3000"
	default y
	depends on MT_FRONTEND
	help
	  Montage Frontend DD330X Driver

if MT_FRONTEND_DMD_DD3K

config MT_FRONTEND_DMD_DD3K_TN_TC6800
	bool "TC6800 Tuner"
	default y
	help
	  Montage TC6800 Tuner

config MT_FRONTEND_DMD_DD3K_TN_TC3800
	bool "TC3800 Tuner"
	default y
	help
	  Montage TC3800 Tuner

config MT_FRONTEND_DMD_DD3K_TN_MXL603
	bool "MXL603 Tuner"
	default n
	help
	  Montage MXL603 Tuner

config MT_FRONTEND_DMD_DD3K_TN_MXL608
	bool "MXL608 Tuner"
	default n
	help
	  Montage MXL608 Tuner
	  
endif #MT_FRONTEND_DMD_DD3K
```

## msp/drv/frontend/rs6060/Kconfig
```kconfig
menuconfig MT_FRONTEND_DMD_RS6060
	bool "RS6060"
	default y
	depends on MT_FRONTEND
	help
	  Montage Frontend RS6060 Driver
```

## msp/drv/frontend/sony_cxd2856/Kconfig
```kconfig
menuconfig MT_FRONTEND_DMD_SONY_CXD2856
	bool "SONY_CXD2856"
	default n
	depends on MT_FRONTEND
	help
	  Sony Frontend CXD2856 Driver

if MT_FRONTEND_DMD_SONY_CXD2856

config MT_FRONTEND_DMD_SONY_CXD2856_TN_MXL608
	bool "MxL608 Tuner"
	default y
	help
	  MaxLinear MxL603 or 608 Tuner

config MT_FRONTEND_DMD_SONY_CXD2856_TN_R850
	bool "R850 Tuner"
	default y
	help
	  Rafael R850 Tuner

config MT_FRONTEND_DMD_SONY_CXD2856_TN_R858C
	bool "R858C dual Tuner"
	default y
	help
	  Rafael R858C dual Tuner

config MT_FRONTEND_DMD_SONY_CXD2856_TN_R836
	bool "R836 Tuner"
	default y
	help
	  Rafael R836 Tuner

config MT_FRONTEND_DMD_SONY_CXD2856_TN_TC6800
	bool "TC6800 Tuner"
	default y
	help
	Montage TC6800 Tuner

endif #MT_FRONTEND_DMD_SONY_CXD2856
```

## msp/drv/frontend/sony_cxd_family/Kconfig
```kconfig
menuconfig MT_FRONTEND_DMD_SONY_CXD_FAMILY
	bool "SONY_CXD"
	default n
	depends on MT_FRONTEND
	help
	  Sony Frontend CXD Family Driver

if MT_FRONTEND_DMD_SONY_CXD_FAMILY

config MT_FRONTEND_DMD_SONY_CXD_FAMILY_TN_MXL608
	bool "MxL608 Tuner"
	default y
	help
	  MaxLinear MxL603 or 608 Tuner

config MT_FRONTEND_DMD_SONY_CXD_FAMILY_TN_R850
	bool "R850 Tuner"
	default y
	help
	  Rafael R850 Tuner

config MT_FRONTEND_DMD_SONY_CXD_FAMILY_TN_R858C
	bool "R858C dual Tuner"
	default y
	help
	  Rafael R858C dual Tuner

config MT_FRONTEND_DMD_SONY_CXD_FAMILY_TN_R836
	bool "R836 Tuner"
	default y
	help
	  Rafael R836 Tuner

config MT_FRONTEND_DMD_SONY_CXD_FAMILY_TN_TC6800
	bool "TC6800 Tuner"
	default y
	help
	Montage TC6800 Tuner

endif #MT_FRONTEND_DMD_SONY_CXD_FAMILY
```

## msp/drv/frontend/tc6930/Kconfig
```kconfig
config MT_FRONTEND_DMD_TENOR
	bool "TENOR"
	default y
	depends on MT_FRONTEND
	help
	  Montage Frontend TENOR(TC6920/TC6930/TC6960) Driver
```

## msp/drv/frontend/tp5001/Kconfig
```kconfig
menuconfig MT_FRONTEND_DMD_TP5001
	bool "TP5001"
	default n
	depends on MT_FRONTEND
	help
	  TelePath Frontend TP5001 Driver
```

## msp/drv/keyled/Kconfig
```kconfig
menuconfig MT_KEYLED
	bool "Keyled"
	default y
	depends on MT_MSP
	help
	  Montage Frontpanel Keyled Driver

if MT_KEYLED

config MT_KEYLED_CT1642
	bool "CT1642 Keyled"
	default y
	help
	  Montage CT1642 Keyled

config MT_KEYLED_FD650
	bool "FD650 Keyled"
	default y
	help
	  Montage FD650 Keyled

config MT_KEYLED_ADC
	bool "ADC Keyled"
	default y
	help
	  Montage ADC Keyled

config MT_KEYLED_TT1629B
	bool "TT1629B Keyled"
	default y
	help
	  Montage TT1629B Keyled

config MT_KEYLED_PT6393
	bool "PT6393 Keyled"
	default y
	help
	  Montage PT6393 Keyled

config MT_KEYLED_FD612
	bool "FD612 Keyled"
	default y
	help
	  Montage FD612
endif #MT_KEYLED
```

## msp/drv/keytable/Kconfig
```kconfig
menuconfig MT_KEYTABLE
	bool "Keytable"
	default y
	depends on MT_SECURITY
	help
	  Montage Keytable Driver

if MT_KEYTABLE

config MT_KEYTABLE_SYM2
	bool "Keytable sym2"
	default y
	depends on MT_CHIP_SYMPHONY2
	help
	  Montage Keytable sym2 driver

config MT_KEYTABLE_SYM4
	bool "Keytable sym4"
	default y
	depends on MT_CHIP_SYMPHONY4
	help
	  Montage Keytable sym4 driver

config MT_KEYTABLE_SYM6
	bool "Keytable sym6"
	default y
	depends on MT_CHIP_SYMPHONY6
	help
	  Montage Keytable sym6 driver

endif #MT_KEYTABLE
```
