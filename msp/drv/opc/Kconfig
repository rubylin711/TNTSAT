## msp/drv/opc/Kconfig
```kconfig
menuconfig MT_OPC
	bool "OPC"
	default y
	depends on MT_SECURITY  && (MT_CHIP_SYMPHONY6)
	help
	Montage Vendor Specific Security Subsystem

if MT_OPC

config MT_OUTPUT_POLICY
	bool "Output Policy"
	default y
	help
	Montage SMP Output Policy

endif #MT_OPC
```

## msp/drv/vss/Kconfig
```kconfig
menuconfig MT_VSS
	bool "VSS"
	default y
	depends on MT_SECURITY && (MT_CHIP_SYMPHONY4 || MT_CHIP_SYMPHONY6)
	help
	Montage Vendor Specific Security Subsystem

if MT_VSS

config MT_VSS_MB
	bool "VSS Mailbox"
	default y
	help
	Montage VSS Mailbox

endif #MT_VSS
```
